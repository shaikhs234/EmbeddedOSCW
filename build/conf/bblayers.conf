## build/conf/bblayers.conf
```bitbake
# POKY_BBLAYERS_CONF_VERSION is increased each time build/conf/bblayers.conf
# changes incompatibly
POKY_BBLAYERS_CONF_VERSION = "2"

BBPATH = "${TOPDIR}"
BBFILES ?= ""

BBLAYERS ?= " \
  /home/shkhmaaz/Desktop/Lab/Lab/yocto/poky/meta \
  /home/shkhmaaz/Desktop/Lab/Lab/yocto/poky/meta-poky \
  /home/shkhmaaz/Desktop/Lab/Lab/yocto/poky/meta-yocto-bsp \
  /home/shkhmaaz/Desktop/Lab/Lab/yocto/meta-raspberrypi \
  /home/shkhmaaz/Desktop/Lab/Lab/yocto/meta-openembedded/meta-oe \
  /home/shkhmaaz/Desktop/Lab/Lab/yocto/meta-openembedded/meta-python \
  /home/shkhmaaz/Desktop/Lab/Lab/yocto/meta-openembedded/meta-networking \
  /home/shkhmaaz/Desktop/Lab/Lab/yocto/meta-openembedded/meta-multimedia \
  /home/shkhmaaz/Desktop/Lab/Lab/yocto/meta-coursework \
  "
```

## meta-coursework/conf/layer.conf
```bitbake
# We have a conf and classes directory, add to BBPATH
BBPATH .= ":${LAYERDIR}"

# We have recipes-* directories, add to BBFILES
BBFILES += "${LAYERDIR}/recipes-*/*/*.bb \
            ${LAYERDIR}/recipes-*/*/*.bbappend"

BBFILE_COLLECTIONS += "meta-coursework"
BBFILE_PATTERN_meta-coursework = "^${LAYERDIR}/"
BBFILE_PRIORITY_meta-coursework = "6"

LAYERDEPENDS_meta-coursework = "core"
LAYERSERIES_COMPAT_meta-coursework = "dunfell"
```
